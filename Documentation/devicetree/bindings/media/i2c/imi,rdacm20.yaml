## Documentation/devicetree/bindings/media/i2c/imi,rdacm20.yaml
```yaml
# SPDX-License-Identifier: GPL-2.0 OR BSD-2-Clause
# Copyright (C) 2019 Renesas Electronics Corp.
%YAML 1.2
---
$id: http://devicetree.org/schemas/media/i2c/imi,rdacm20.yaml#
$schema: http://devicetree.org/meta-schemas/core.yaml#

title:  IMI D&D RDACM20 Automotive Camera Platform

maintainers:
  - Jacopo Mondi <jacopo+renesas@jmondi.org>
  - Kieran Bingham <kieran.bingham+renesas@ideasonboard.com>
  - Laurent Pinchart <laurent.pinchart+renesas@ideasonboard.com>
  - Niklas Söderlund <niklas.soderlund+renesas@ragnatech.se>

description: -|
  The IMI D&D RDACM20 is a GMSL-compatible camera designed for automotive
  applications. It encloses a Maxim Integrated MAX9271 GMSL serializer, an
  Omnivision OV10635 camera sensor and an embedded MCU, and connects to a remote
  GMSL endpoint through a coaxial cable.

                                                   IMI RDACM20
  +---------------+                        +--------------------------------+
  |      GMSL     |   <- Video Stream      |       <- Video--------\        |
  |               |< === GMSL Link ====== >|MAX9271<- I2C bus-> <-->OV10635 |
  | de-serializer |   <- I2C messages ->   |                   \<-->MCU     |
  +---------------+                        +--------------------------------+

  The RDACM20 transmits video data generated by the embedded camera sensor on
  the GMSL serial channel to a remote GMSL de-serializer, as well as it receives
  and transmits I2C messages encapsulated in the GMSL bidirectional control
  channel.

  All I2C traffic received on the GMSL link not directed to the serializer is
  propagated on the local I2C bus to the embedded camera sensor and MCU. All I2C
  traffic generated on the local I2C bus not directed to the serializer is
  propagated to the remote de-serializer encapsulated in the GMSL control
  channel.

  The RDACM20 DT node should be a direct child of the GMSL Deserializer's I2C
  bus corresponding to the GMSL link that the camera is attached to.

properties:
  '#address-cells':
    const: 1

  '#size-cells':
    const: 0

  compatible:
    const: imi,rdacm20

  reg:
    description: -|
      I2C device addresses, the first to be assigned to the serializer the
      second to be assigned to the camera sensor. An optional third address can
      be provided to specify the MCU address if present.
    minItems: 2
    maxItems: 3

  port:
    type: object
    additionalProperties: false
    description: -|
      Connection to the remote GMSL endpoint are modelled using the OF graph
      bindings in accordance with the video interface bindings defined in
      Documentation/devicetree/bindings/media/video-interfaces.txt.

      The device node contains a single "port" child node with a single
      "endpoint" sub-device.

    properties:
      endpoint:
        type: object
        additionalProperties: false

        properties:
          remote-endpoint:
            description: -|
              phandle to the remote GMSL endpoint sub-node in the remote node
              port.
            maxItems: 1

        required:
          - remote-endpoint

    required:
      - endpoint

required:
  - compatible
  - reg
  - port

examples:
  - |
    i2c@e66d8000 {
      #address-cells = <1>;
      #size-cells = <0>;

      reg = <0 0xe66d8000 0 0x40>;

      camera@31 {
        compatible = "imi,rdacm20";
        reg = <0x31>, <0x41>, <0x51>;

        port {
          rdacm20_out0: endpoint {
            remote-endpoint = <&max9286_in0>;
          };
        };
      };
    };
```
